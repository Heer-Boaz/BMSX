`timescale 1ns/1ps
// Real 16-slot scheduler -> cursor -> BADP decoder/interpolator/filter/mixer.
// 48 frames and eight independent stereo sources are generated by the actual
// TS mixer and checked independently by C++. RAM is a one-clock word fixture;
// source bind, raw rate words and per-slot gain are supplied by this test.
module apu_voice_cursor_mix_tb;
 reg clk=0;always #5 clk=~clk;reg reset_n=0;
 reg frame_valid=0,output_ready=0;wire frame_ready,frame_done,decoder_begin;
 wire start_valid,start_ready,dispatch_valid,dispatch_ready,dispatch_active;
 wire [3:0] dispatch_slot;wire frame_out_valid,frame_out_ready;
 apu_frame_scheduler scheduler(.clk(clk),.reset_n(reset_n),.frame_valid(frame_valid),.frame_ready(frame_ready),.frame_done(frame_done),.active_mask(16'h00ff),.decoder_epoch_begin(decoder_begin),.worker_start_valid(start_valid),.worker_start_ready(start_ready),.worker_slot_valid(dispatch_valid),.worker_slot_ready(dispatch_ready),.worker_slot_index(dispatch_slot),.worker_slot_active(dispatch_active),.worker_frame_valid(frame_out_valid),.worker_frame_ready(frame_out_ready),.output_ready(output_ready));
 reg rate_valid=0,rate_rsp_ready=0;wire rate_ready,rate_rsp_valid;wire signed [63:0] rate_whole;wire signed [31:0] rate_remainder;
 apu_voice_rate rate(.clk(clk),.reset_n(reset_n),.req_valid(rate_valid),.req_ready(rate_ready),.req_rate_q16(32'h00008000),.req_source_hz(32'd44100),.rsp_valid(rate_rsp_valid),.rsp_ready(rate_rsp_ready),.rsp_whole_q16(rate_whole),.rsp_remainder(rate_remainder));
 reg load_valid=0;reg [3:0] load_slot=0;wire load_ready,cursor_valid,cursor_ready,cursor_active,cursor_ended;wire [3:0] cursor_slot;wire [31:0] cursor_frame,cursor_neighbor;wire [15:0] cursor_fraction;
 apu_voice_cursor cursor(.clk(clk),.reset_n(reset_n),.load_valid(load_valid),.load_ready(load_ready),.load_slot(load_slot),.load_cursor_q16(64'sd65536),.load_step_q16(rate_whole),.load_remainder(32'sd0),.load_step_remainder(rate_remainder),.load_frames(32'd8),.load_loop_start(32'd1),.load_loop_end(32'd7),.req_valid(dispatch_valid),.req_ready(dispatch_ready),.req_slot(dispatch_slot),.req_active(dispatch_active),.rsp_valid(cursor_valid),.rsp_ready(cursor_ready),.rsp_slot(cursor_slot),.rsp_active(cursor_active),.rsp_ended(cursor_ended),.rsp_frame(cursor_frame),.rsp_neighbor(cursor_neighbor),.rsp_fraction(cursor_fraction),.rsp_next_cursor_q16(),.rsp_next_remainder());
 reg bind_valid=0;reg [3:0] bind_voice=0;reg [18:0] bind_base=0;wire mem_valid;wire [16:0] mem_addr;reg mem_rsp_valid=0;reg [31:0] mem_rsp_word=0;reg [31:0] memory[0:1023];
 reg [31:0] gains[0:7];reg [31:0] exp_frame[0:7],exp_neighbor[0:7],exp_fraction[0:7],exp_gain[0:7],exp_reset[0:7];integer epoch=0;
 wire signed [15:0] out_left,out_right;
 apu_badp_mix mixer(.clk(clk),.reset_n(reset_n),.bind_valid(bind_valid),.bind_voice(bind_voice),.bind_source_base(bind_base),.bind_source_bytes(20'd92),.bind_data_offset(19'd72),.bind_frames(32'd8),.bind_channels(2'd2),.bind_seek_base(bind_base+19'd64),.bind_seek_count(32'd1),.bind_loop_start(32'd1),.bind_loop_end(32'd7),.source_write_valid(1'b0),.source_write_word(17'd0),.source_write_words(5'd0),.epoch_begin(decoder_begin),.epoch_active(1'b1),.epoch_change_valid(1'b0),.epoch_change_first(17'd0),.epoch_change_last(17'd0),.memory_req_valid(mem_valid),.memory_req_ready(1'b1),.memory_req_word_address(mem_addr),.memory_rsp_valid(mem_rsp_valid),.memory_rsp_word(mem_rsp_word),.pcm_memory_req_valid(),.pcm_memory_req_ready(1'b0),.pcm_memory_req_address(),.pcm_memory_rsp_valid(1'b0),.pcm_memory_rsp_word(32'd0),.start_valid(start_valid),.start_ready(start_ready),.slot_valid(cursor_valid),.slot_ready(cursor_ready),.slot_active(cursor_active),.slot_generator_kind(32'd0),.slot_generator_duty_q12(32'd0),.slot_reset(epoch==0 && cursor_active),.slot_bits_per_sample(32'd4),.slot_channels(32'd2),.slot_data_address(32'd0),.slot_frame(cursor_frame),.slot_neighbor(cursor_neighbor),.slot_fraction(cursor_fraction),.slot_gain_q12(cursor_active ? gains[cursor_slot] : 32'd0),.slot_level_lr_q14(32'h40004000),.slot_filter_clear(1'b0),.slot_filter_control(32'd0),.slot_filter_b0_b1(32'd0),.slot_filter_b2_a1(32'd0),.slot_filter_a2(32'd0),.frame_valid(frame_out_valid),.frame_ready_out(frame_out_ready),.frame_left(out_left),.frame_right(out_right));
 always @(posedge clk)begin
  mem_rsp_valid<=mem_valid;if(mem_valid)mem_rsp_word<=memory[mem_addr];
  if(cursor_valid&&cursor_ready)begin
   if(cursor_slot<8)begin
    if(!cursor_active||cursor_ended||cursor_frame!==exp_frame[cursor_slot]||cursor_neighbor!==exp_neighbor[cursor_slot]||cursor_fraction!==exp_fraction[cursor_slot][15:0]||gains[cursor_slot]!==exp_gain[cursor_slot]||exp_reset[cursor_slot]!=(epoch==0))
     $fatal(1,"cursor slot %d epoch %d frame=%d/%d neighbor=%d/%d frac=%d/%d",cursor_slot,epoch,cursor_frame,exp_frame[cursor_slot],cursor_neighbor,exp_neighbor[cursor_slot],cursor_fraction,exp_fraction[cursor_slot]);
   end else if(cursor_active) $fatal(1,"inactive slot became active");
  end
 end
 integer f,scan,frames,voices,words,channels,i;reg [31:0] word,expected;integer elapsed,max_elapsed=0,misses=0,cycle=0,start_cycle;
 always @(posedge clk)cycle<=cycle+1;
 initial begin
  f=$fopen("build/tests/apu-badp-mix-vectors.txt","r");if(!f)$fatal(1,"vectors missing");
  scan=$fscanf(f,"%d %d %d %d",frames,voices,words,channels);if(scan!=4||voices!=8||channels!=2)$fatal(1,"fixture header");
  for(i=0;i<words;i=i+1)begin scan=$fscanf(f,"%h",word);if(scan!=1)$fatal(1,"fixture words");memory[i]=word;end
  gains[0]=4096;gains[1]=2048;gains[2]=-2048;gains[3]=1024;gains[4]=8192;gains[5]=-4096;gains[6]=3333;gains[7]=777;
  repeat(2)@(negedge clk);reset_n=1;
  @(negedge clk);while(!rate_ready)@(negedge clk);rate_valid=1;@(negedge clk);rate_valid=0;while(!rate_rsp_valid)@(negedge clk);
  for(i=0;i<8;i=i+1)begin @(negedge clk);bind_valid=1;bind_voice=i;bind_base=i*128;load_valid=1;load_slot=i;@(negedge clk);bind_valid=0;load_valid=0;end
  rate_rsp_ready=1;@(negedge clk);rate_rsp_ready=0;
  for(epoch=0;epoch<frames;epoch=epoch+1)begin
   for(i=0;i<8;i=i+1)begin scan=$fscanf(f,"%d %d %d %h %d",exp_frame[i],exp_neighbor[i],exp_fraction[i],exp_gain[i],exp_reset[i]);if(scan!=5)$fatal(1,"frame vector");end
   scan=$fscanf(f,"%h",expected);if(scan!=1)$fatal(1,"output vector");
   @(negedge clk);while(!frame_ready)@(negedge clk);frame_valid=1;start_cycle=cycle;@(negedge clk);frame_valid=0;
   while(!frame_out_valid)@(negedge clk);elapsed=cycle-start_cycle;if(elapsed>max_elapsed)max_elapsed=elapsed;if(elapsed>768)misses=misses+1;
   if({out_right,out_left}!==expected)$fatal(1,"epoch %0d expected=%h got=%h",epoch,expected,{out_right,out_left});
   repeat(epoch%3)begin @(negedge clk);if(!frame_out_valid||frame_done||{out_right,out_left}!==expected)$fatal(1,"stalled output");end
   output_ready=1;@(negedge clk);output_ready=0;
  end
  $display("PASS %0d frames: actual rate converter, 16-slot scheduler, per-slot cursor and BADP mixer vs TS/C++; eight stereo voices, word-memory fixture, max clocks %0d, deadline misses %0d",frames,max_elapsed,misses);$finish;
 end
 initial begin #5000000;$fatal(1,"timeout");end
endmodule
