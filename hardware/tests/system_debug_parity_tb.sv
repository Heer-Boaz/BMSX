`timescale 1ns/1ps
// Replay operation/byte/readback expectations generated by the actual TS
// Memory + SystemDebugTransmit. The C++ replay checks the same vectors.
// Concurrent sink transfers take effect before the admitted bus operation.
module system_debug_parity_tb;
 reg clk=0;always #5 clk=!clk;
 reg reset_n=0,access_valid=0,access_write=0,byte_ready=0;
 reg [31:0] access_address=0,access_wdata=0;
 wire access_ready,response_valid,byte_valid;
 wire [31:0] response_data;wire [7:0] byte_data;
 system_debug_transmit dut(.*);
 string vectors="build/tests/system-debug-vectors.txt";
 integer f,scan,op,count=0;
 reg [31:0] value,expected;
 reg stalled=0;reg [7:0] held;
 initial begin #5000000;$fatal(1,"watchdog op %0d",count);end
 always @(posedge clk) begin
  if(!reset_n) stalled<=0;
  else begin
   if(stalled && (!byte_valid || byte_data!==held)) $fatal(1,"output changed under backpressure at op %0d",count);
   stalled<=byte_valid && !byte_ready;
   if(byte_valid && !byte_ready) held<=byte_data;
  end
 end
 initial begin
  if($value$plusargs("VECTORS=%s",vectors)) begin end
  f=$fopen(vectors,"r");if(f==0)$fatal(1,"cannot open vectors %s",vectors);
  repeat(3) @(negedge clk);reset_n=1;
  scan=$fscanf(f,"%d %h %h",op,value,expected);
  while(scan==3) begin
   case(op)
    0,1,2,3,6,7: begin
     @(negedge clk);
     while(!access_ready) @(negedge clk);
     access_valid=1;access_write=(op==0 || op==1 || op==6 || op==7);
     access_address=(op==0 || op==2 || op==6) ? 32'h08010230 : 32'h08010234;
     access_wdata=value;
     if(op==6 || op==7) begin
      if(!byte_valid || byte_data!==expected[7:0]) $fatal(1,"pop/write op %0d expected %h got %h valid=%b",count,expected[7:0],byte_data,byte_valid);
      byte_ready=1;
     end
     @(negedge clk);
     access_valid=0;access_write=0;byte_ready=0;
     if(!response_valid) $fatal(1,"missing response at op %0d",count);
     if((op==2 || op==3) && response_data!==expected)
      $fatal(1,"register op %0d expected %h got %h",count,expected,response_data);
    end
    4: begin
     @(negedge clk);
     if(!byte_valid || byte_data!==expected[7:0]) $fatal(1,"pop op %0d expected %h got %h valid=%b",count,expected[7:0],byte_data,byte_valid);
     byte_ready=1;@(negedge clk);byte_ready=0;
    end
    5: begin @(negedge clk);reset_n=0;@(negedge clk);reset_n=1;end
    8: begin
     @(negedge clk);
     if(byte_valid!==(expected!=0)) $fatal(1,"availability op %0d expected count %0d valid=%b",count,expected,byte_valid);
    end
    default: $fatal(1,"unknown op %0d",op);
   endcase
   count=count+1;
   scan=$fscanf(f,"%d %h %h",op,value,expected);
  end
  if(!$feof(f)) $fatal(1,"invalid vector record after %0d ops",count);
  $fclose(f);
  $display("PASS %0d actual TS/C++ memory/transmit operations, output stalls and concurrent bus/byte handshakes",count);
  $finish;
 end
endmodule
