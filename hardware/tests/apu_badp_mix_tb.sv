`timescale 1ns/1ps
// Mono/stereo BADP voices on the real sample-store/ISSI pin path, connected
// through the actual BADP/interpolation/mixer stages. Golden 48-frame output is
// generated by TS and independently replayed by C++ ApuOutputMixer. The caller
// supplies exact voice cursor/neighbor/fraction; it is not the APU MMIO, source
// binder, rate/loop scheduler, filter/fade engine, DAC or a deadline guarantee.
module apu_badp_mix_tb;
 localparam real PERIOD=1000000000.0/33868800.0;
 reg clk=0;always #(PERIOD/2.0) clk=~clk;
 reg reset_n=0,store_reset_n=0,power_reset_n=0;
 reg bind_valid=0;reg [3:0] bind_voice=0;reg [18:0] bind_source_base=0,bind_data_offset=0,bind_seek_base=0;
 reg [19:0] bind_source_bytes=0;reg [31:0] bind_frames=0,bind_seek_count=0,bind_loop_start=0,bind_loop_end=0;
 reg [1:0] bind_channels=0;reg source_write_valid=0;reg [16:0] source_write_word=0;
 reg [4:0] source_write_words=0;reg epoch_begin=0,epoch_active=0;wire epoch_change_valid=0;wire [16:0] epoch_change_first=0,epoch_change_last=0;
 wire memory_req_valid,memory_req_ready,memory_rsp_valid;wire [16:0] memory_req_word_address;wire [31:0] memory_rsp_word;
 wire pcm_memory_req_valid;wire [31:0] pcm_memory_req_address;
 wire pcm_memory_req_ready=0,pcm_memory_rsp_valid=0;wire [31:0] pcm_memory_rsp_word=0;
 reg start_valid=0,slot_valid=0,slot_active=0,slot_reset=0,frame_ready_out=0;
 reg [31:0] slot_frame=0,slot_neighbor=0;reg [15:0] slot_fraction=0;reg signed [31:0] slot_gain_q12=0;
 wire [31:0] slot_bits_per_sample=4,slot_channels=2,slot_data_address=0;
 wire [31:0] slot_generator_kind=0,slot_generator_duty_q12=0;
 reg [31:0] slot_level_lr_q14=32'h40004000;
 reg slot_filter_clear=0;reg [31:0] slot_filter_control=0,slot_filter_b0_b1=0,slot_filter_b2_a1=0,slot_filter_a2=0;
 wire start_ready,slot_ready,frame_valid;wire signed [15:0] frame_left,frame_right;
 apu_badp_mix dut(.*);
 wire [17:0] mem_address;tri [15:0] mem_data;wire mem_ce_n,mem_oe_n,mem_we_n;wire [1:0] mem_be_n;
 wire memory_ready,chip_drives,store_rsp_valid,store_req_ready;wire [31:0] store_rsp_data;
 reg pcm_selected=0,pcm_req_valid=0,pcm_rsp_ready=0;
 reg [31:0] pcm_address=0,pcm_channels=0,pcm_depth=0;
 wire pcm_req_ready,pcm_word_valid,pcm_frame_valid;wire [31:0] pcm_word_address,pcm_samples;
 apu_pcm_frame pcm(.clk(clk),.reset_n(reset_n),.req_valid(pcm_req_valid),.req_ready(pcm_req_ready),
  .req_byte_address(pcm_address),.req_channels(pcm_channels),.req_bits_per_sample(pcm_depth),
  .memory_req_valid(pcm_word_valid),.memory_req_ready(pcm_selected && store_req_ready),
  .memory_req_address(pcm_word_address),.memory_rsp_valid(pcm_selected && store_rsp_valid),
  .memory_rsp_word(store_rsp_data),.rsp_valid(pcm_frame_valid),.rsp_ready(pcm_rsp_ready),.rsp_samples(pcm_samples));
 apu_sample_store store(.clk(clk),.reset_n(store_reset_n),.power_reset_n(power_reset_n),
  .req_valid(pcm_selected ? pcm_word_valid : memory_req_valid),.req_ready(store_req_ready),.req_write(1'b0),
  .req_word_address(pcm_selected ? pcm_word_address[18:2] : memory_req_word_address),.req_wdata(32'd0),.req_be_n(4'd0),
  .rsp_valid(store_rsp_valid),.rsp_rdata(store_rsp_data),.memory_ready(memory_ready),
  .mem_address(mem_address),.mem_data(mem_data),.mem_ce_n(mem_ce_n),.mem_oe_n(mem_oe_n),
  .mem_we_n(mem_we_n),.mem_be_n(mem_be_n));
 assign memory_req_ready=!pcm_selected && store_req_ready;
 assign memory_rsp_valid=!pcm_selected && store_rsp_valid;assign memory_rsp_word=store_rsp_data;
 issi_bll_pin_model #(.ADDRESS_WIDTH(18),.PATTERN(16'hbad8)) device(.address(mem_address),.data(mem_data),
  .ce_n(mem_ce_n),.oe_n(mem_oe_n),.we_n(mem_we_n),.be_n(mem_be_n),.drive_active(chip_drives));
 integer cycle=0,reads=0;always @(posedge clk) begin cycle<=cycle+1;if(memory_req_valid && memory_req_ready) reads<=reads+1;end
 always @(mem_data or chip_drives or store.pins.data_drive)
  if(chip_drives && store.pins.data_drive) $fatal(1,"SRAM drivers overlap");
 integer f,scan,frames,voices,words,channels,offset=0,epoch,v,slot,base,start_cycle,elapsed,max_cycles=0,misses=0;
 integer bank,bank_count=2,scenario,scenario_count=1,slot_base_override=0,has_slot_base=0;
 integer first_cycles=0,steady_max=0,steady_misses=0;
 integer a,b,fraction,reset_flag,gain;reg [31:0] word,expected,held;
 string vectors="build/tests/apu-badp-mix-vectors.txt";
 string vectors_extra1,vectors_extra2,vectors_pan_left,pcm_vectors;
 integer has_pcm_vectors=0,pcm_count,pcm_n,pcm_i;
 reg [31:0] pcm_expected;
 initial begin #1000000000;$fatal(1,"BADP/mixer watchdog");end
 initial begin
  if($value$plusargs("VECTORS=%s",vectors)) begin end
  if($value$plusargs("VECTORS_EXTRA1=%s",vectors_extra1)) scenario_count=2;
  if($value$plusargs("VECTORS_EXTRA2=%s",vectors_extra2)) scenario_count=3;
  if($value$plusargs("VECTORS_PAN_L=%s",vectors_pan_left)) scenario_count=4;
  if($value$plusargs("PCM_VECTORS=%s",pcm_vectors)) has_pcm_vectors=1;
  if($value$plusargs("SLOT_BASE=%d",slot_base_override)) has_slot_base=1;
  repeat(20) @(negedge clk);power_reset_n=1;store_reset_n=1;
  wait(memory_ready);@(negedge clk);
  for(scenario=0;scenario<scenario_count;scenario=scenario+1) begin
  if(scenario==1) vectors=vectors_extra1;
  if(scenario==2) vectors=vectors_extra2;
  if(scenario==3) vectors=vectors_pan_left;
  slot_level_lr_q14=scenario==3 ? 32'h00004000 : 32'h40004000;
  offset=slot_base_override;
  f=$fopen(vectors,"r");if(f==0)$fatal(1,"cannot open vectors");
  scan=$fscanf(f,"%d %d %d %d",frames,voices,words,channels);if(scan!=4)$fatal(1,"vector header");
  bank_count=voices==16 ? 1 : 2;
  if(has_slot_base!=0) bank_count=1;
  for(bank=0;bank<bank_count;bank=bank+1) begin
  // All trials share the same actual SRAM power-on clear; the fixture images
  // are installed directly in the SRAM pin model, not via a live upload.
  if(bank!=0 || scenario!=0) begin
   reset_n=0;repeat(2) @(negedge clk);offset=8;reads=0;
   if(bank==0) offset=slot_base_override;
  end
  if(bank!=0) begin
   f=$fopen(vectors,"r");if(f==0)$fatal(1,"cannot reopen vectors");
   scan=$fscanf(f,"%d %d %d %d",frames,voices,words,channels);if(scan!=4)$fatal(1,"vector header");
  end
  max_cycles=0;misses=0;first_cycles=0;steady_max=0;steady_misses=0;
  for(v=0;v<words;v=v+1) begin
   scan=$fscanf(f,"%h",word);if(scan!=1)$fatal(1,"truncated image");
   device.words[v*2]=word[15:0];device.words[v*2+1]=word[31:16];
  end
  reset_n=1;@(negedge clk);
  for(v=0;v<voices;v=v+1) begin
   base=v*128;bind_valid=1;bind_voice=v+offset;bind_source_base=base;bind_source_bytes=76+8*channels;
   bind_data_offset=72;bind_frames=8;bind_channels=channels;bind_seek_base=base+64;bind_seek_count=1;
   bind_loop_start=1;bind_loop_end=7;@(negedge clk);
  end
  bind_valid=0;
  for(epoch=0;epoch<frames;epoch=epoch+1) begin
   start_cycle=cycle;epoch_begin=1;@(negedge clk);epoch_begin=0;
   while(!start_ready) @(negedge clk);start_valid=1;@(negedge clk);start_valid=0;
   for(slot=0;slot<16;slot=slot+1) begin
    while(!slot_ready) @(negedge clk);
    if(slot>=offset && slot<offset+voices) begin
     scan=$fscanf(f,"%d %d %d %h %d",a,b,fraction,gain,reset_flag);
     if(scan!=5)$fatal(1,"truncated frame %0d slot %0d",epoch,slot);
     slot_active=1;slot_reset=reset_flag;slot_frame=a;slot_neighbor=b;slot_fraction=fraction;slot_gain_q12=gain;
    end else begin slot_active=0;slot_reset=0;slot_frame=0;slot_neighbor=0;slot_fraction=0;slot_gain_q12=0;end
    slot_valid=1;@(negedge clk);slot_valid=0;
   end
   scan=$fscanf(f,"%h",expected);if(scan!=1)$fatal(1,"missing golden frame");
   // The optional fourth fixture is eight mono sources. Its original runtime
   // oracle is centered, so unity-left/zero-right preserves exactly its low
   // word and silences the high word without inventing a second audio model.
   if(scenario==3) begin
    if(expected[15:0]!==expected[31:16]) $fatal(1,"pan fixture is not centered mono");
    expected[31:16]=0;
   end
   while(!frame_valid) @(negedge clk);
   elapsed=cycle-start_cycle;if(elapsed>max_cycles)max_cycles=elapsed;if(elapsed>768)misses=misses+1;
   if(epoch==0) first_cycles=elapsed;
   else begin if(elapsed>steady_max)steady_max=elapsed;if(elapsed>768)steady_misses=steady_misses+1;end
   held={frame_right,frame_left};if(held!==expected)$fatal(1,"epoch %0d expected=%h got=%h",epoch,expected,held);
   repeat(3) begin @(negedge clk);if(!frame_valid || {frame_right,frame_left}!==held)$fatal(1,"output backpressure");end
   frame_ready_out=1;@(negedge clk);frame_ready_out=0;
  end
  $fclose(f);
  $display("PASS %0d TS/C++ BADP frames, slots %0d-%0d, channels %0d, level=%h, real SRAM pins, loops, cold starts, half-rate interpolation and backpressure",frames,offset,offset+voices-1,channels,slot_level_lr_q14);
  $display("MEASURE epoch_begin_to_output frames=%0d over_768=%0d max_clocks=%0d first=%0d steady_max=%0d steady_over_768=%0d physical_word_reads=%0d (testbench schedule, not a physical frame-deadline guarantee)",frames,misses,max_cycles,first_cycles,steady_max,steady_misses,reads);
  end
  end
  // Run the PCM source-frame owner through this same actual SRAM controller
  // and pin model, sharing the completed power-clear. The fixture bytes are
  // installed directly into the model; source binding/upload are not tested.
  if(has_pcm_vectors!=0) begin
   reset_n=0;repeat(2) @(negedge clk);pcm_selected=1;
   for(pcm_i=0;pcm_i<64;pcm_i=pcm_i+1)
    device.words[pcm_i]={8'((pcm_i*2+1)*73+91),8'((pcm_i*2)*73+91)};
   f=$fopen(pcm_vectors,"r");if(f==0)$fatal(1,"cannot open PCM vectors");
   scan=$fscanf(f,"%d",pcm_count);if(scan!=1)$fatal(1,"missing PCM count");
   reset_n=1;
   for(pcm_n=0;pcm_n<pcm_count;pcm_n=pcm_n+1) begin
    scan=$fscanf(f,"%h %h %h %h",pcm_address,pcm_channels,pcm_depth,pcm_expected);
    if(scan!=4)$fatal(1,"missing PCM vector %0d",pcm_n);
    @(negedge clk);while(!pcm_req_ready) @(negedge clk);pcm_req_valid=1;
    @(negedge clk);pcm_req_valid=0;
    while(!pcm_frame_valid) @(negedge clk);
    if(pcm_samples!==pcm_expected)$fatal(1,"PCM vector %0d expected %h got %h",pcm_n,pcm_expected,pcm_samples);
    pcm_rsp_ready=1;@(negedge clk);pcm_rsp_ready=0;
   end
   $fclose(f);
   $display("PASS %0d PCM frames through sample-store and SRAM pins, TS/C++ decoder oracle, no source binding or live upload",pcm_count);
  end
  $finish;
 end
endmodule
