`timescale 1ns/1ps
// Actual GFX presentation bank -> context owner -> INPUT pad request -> accessory.
// VBlank is stimulated at the bank boundary, not generated by a physical beam.
module gfx_context_to_pad_tb;
 reg clk=0,reset_n=0,write_valid=0;
 always #5 clk=~clk;
 reg [4:0] write_index=0;
 reg [31:0] write_word=0;
 wire context_valid;
 wire [15:0] width,height;
 wire [31:0] epoch;
 wire pad_clk;
 wire [3:0] pad_cmd,pad_select_n;
 wire accessory_data,accessory_oe;
 wire [3:0] pad_data={3'b111,accessory_oe ? accessory_data : 1'b1};
 wire accepted,seen_valid;
 wire [15:0] seen_width,seen_height;
 wire [31:0] seen_epoch;
 gfx_pcrtc_control gfx(.clk(clk),.reset_n(reset_n),.access_valid(write_valid),.access_write(1'b1),
  .access_index(write_index),.access_wdata(write_word),.access_rdata(),.other_events(5'd0),
  .display_context_valid(context_valid),.display_width(width),.display_height(height),.display_epoch(epoch));
 io_controller input_owner(.clk(clk),.reset_n(reset_n),.bus_ad_in(32'd0),.bus_as_n(1'b1),
  .bus_rd_n(1'b1),.bus_wr_n(1'b1),.cs_io_n(1'b1),.bus_be_n(4'hf),
  .bus_ad_out(),.bus_ad_oe(),.bus_ready_drive_low(),.vblank_begin(1'b0),.supervisor_request(1'b0),
  .keyboard_words(256'd0),.snapshot_taken(),.supervisor_edge(),.display_context_valid(context_valid),
  .display_width(width),.display_height(height),.display_epoch(epoch),.pad_clk(pad_clk),
  .pad_cmd(pad_cmd),.pad_select_n(pad_select_n),.pad_data(pad_data),.packet_valid(),.link_error(),
  .dispatch_done(),.dispatch_tag());
 pad_accessory accessory(.clk(clk),.reset_n(reset_n),.pad_clk(pad_clk),.pad_select_n(pad_select_n[0]),
  .pad_command(pad_cmd[0]),.pad_data(accessory_data),.pad_data_oe(accessory_oe),.pad_words(224'd0),
  .pointer_words(128'd0),.request_accepted(accepted),.apply_accepted(),.last_apply_tag(),
  .requested_intensity(),.requested_duration_ms(),.motor_level_q16(),.remaining_ms(),
  .context_valid(seen_valid),.display_width(seen_width),.display_height(seen_height),.display_epoch(seen_epoch));
 task automatic write_config(input [4:0] index,input [31:0] value);
  begin @(negedge clk);write_valid=1;write_index=index;write_word=value;
   @(negedge clk);write_valid=0;end
 endtask
 task automatic present;
  begin @(negedge clk);force gfx.beam.vblank_before_write=8'd1;
   @(negedge clk);release gfx.beam.vblank_before_write;end
 endtask
 initial begin
  repeat(5) @(negedge clk);reset_n=1;
  write_config(0,1);present();
  wait(accepted && seen_valid && seen_width==320 && seen_height==240);@(negedge clk);
  if(seen_epoch!==epoch) $fatal(1,"Initial context epoch did not reach accessory");
  @(negedge pad_select_n[0]);repeat(100) @(negedge clk);
  write_config(5,32'h001df9ff);present();
  @(posedge accepted);@(negedge clk);
  if(!seen_valid || seen_width!==320 || seen_height!==240)
   $fatal(1,"In-flight request was changed by new displayed bank");
  @(posedge accepted);@(negedge clk);
  if(!seen_valid || seen_width!==640 || seen_height!==480 || seen_epoch!==epoch)
   $fatal(1,"Subsequent request did not carry complete new displayed context");
  $display("PASS actual GFX display bank to INPUT pad: frame context remains coherent");$finish;
 end
 initial begin #10000000;$fatal(1,"GFX context-to-pad timeout");end
endmodule
